## conf/layer.conf
```bitbake
# We have a conf and classes directory, add to BBPATH
BBPATH .= ":${LAYERDIR}"

# We have recipes-* directories, add to BBFILES
BBFILES += "${LAYERDIR}/recipes-*/*/*.bb \
	${LAYERDIR}/recipes-*/*/*.bbappend"

BBFILE_COLLECTIONS += "baresip"
BBFILE_PATTERN_baresip = "^${LAYERDIR}/"
BBFILE_PRIORITY_baresip = "6"

LAYERSERIES_COMPAT_baresip = "honister"
```
